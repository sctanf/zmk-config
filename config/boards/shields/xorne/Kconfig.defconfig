## config/boards/shields/xorne/Kconfig.defconfig
```kconfig
if SHIELD_XORNE_DONGLE

config ZMK_KEYBOARD_NAME
	default "Xorne"
	
config ZMK_SPLIT_BLE_ROLE_CENTRAL
	default y
	
config ZMK_USB
	default y

endif

if SHIELD_XORNE_LEFT || SHIELD_XORNE_RIGHT

config ZMK_SPLIT
	default y

config ZMK_BLE
	default y
	
endif

if ZMK_BACKLIGHT

config PWM
    default y

config LED_PWM
    default y

endif # ZMK_BACKLIGHT
```

## config/boards/shields/xorne/Kconfig.shield
```kconfig
# Copyright (c) 2020 Pete Johanson
# SPDX-License-Identifier: MIT

config SHIELD_XORNE_LEFT
	def_bool $(shields_list_contains,xorne_left)

config SHIELD_XORNE_RIGHT
	def_bool $(shields_list_contains,xorne_right)
```
